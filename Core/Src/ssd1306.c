/*
 * ssd1306.c
 *
 * Minimal SSD1306 128x32 OLED driver over I2C, for STM32 HAL.
 */

#include "ssd1306.h"
#include "main.h"

extern I2C_HandleTypeDef hi2c1;

#define SSD1306_I2C_TIMEOUT     100

/* Framebuffer: 128 columns x 32 rows, packed 8 vertical pixels per byte,
 * 4 pages of 128 bytes each = 512 bytes total. */
static uint8_t framebuffer[SSD1306_WIDTH * SSD1306_HEIGHT / 8];

static uint8_t cursor_x = 0;
static uint8_t cursor_y = 0;

/* Minimal 5x7 font, ASCII 32 (space) to 126 (~), 5 bytes per character,
 * each byte is one vertical column, bit0 = top pixel. */
static const uint8_t font5x7[][5] = {
    {0x00,0x00,0x00,0x00,0x00}, /* space */
    {0x00,0x00,0x5F,0x00,0x00}, /* ! */
    {0x00,0x07,0x00,0x07,0x00}, /* " */
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    {0x08,0x08,0x2A,0x1C,0x08}, /* ~ */
};

static void SSD1306_WriteCommand(uint8_t cmd)
{
    uint8_t data[2] = {0x00, cmd}; /* control byte 0x00 = command */
    HAL_I2C_Master_Transmit(&hi2c1, SSD1306_I2C_ADDRESS, data, 2, SSD1306_I2C_TIMEOUT);
}

void SSD1306_Init(void)
{
	HAL_Delay(100); /* let the display power up */

    SSD1306_WriteCommand(0xAE); /* display off */
    SSD1306_WriteCommand(0xD5); /* set display clock div */
    SSD1306_WriteCommand(0x80);
    SSD1306_WriteCommand(0xA8); /* set multiplex, 32-row panel */
    SSD1306_WriteCommand(0x1F);
    SSD1306_WriteCommand(0xD3); /* set display offset */
    SSD1306_WriteCommand(0x00);
    SSD1306_WriteCommand(0x40); /* set start line = 0 */
    SSD1306_WriteCommand(0x8D); /* charge pump */
    SSD1306_WriteCommand(0x14);
    SSD1306_WriteCommand(0x20); /* memory addressing mode */
    SSD1306_WriteCommand(0x00); /* horizontal addressing mode */
    SSD1306_WriteCommand(0xA1); /* segment remap */
    SSD1306_WriteCommand(0xC8); /* COM output scan direction, flipped */
    SSD1306_WriteCommand(0xDA); /* set COM pins */
    SSD1306_WriteCommand(0x02); /* 0x02 for 128x32 panels */
    SSD1306_WriteCommand(0x81); /* set contrast */
    SSD1306_WriteCommand(0x8F);
    SSD1306_WriteCommand(0xD9); /* set precharge period */
    SSD1306_WriteCommand(0xF1);
    SSD1306_WriteCommand(0xDB); /* set VCOM deselect level */
    SSD1306_WriteCommand(0x40);
    SSD1306_WriteCommand(0xA4); /* entire display on (resume from RAM) */
    SSD1306_WriteCommand(0xA6); /* normal (not inverted) display */
    SSD1306_WriteCommand(0xAF); /* display on */

    SSD1306_Clear();
    SSD1306_UpdateScreen();
}

void SSD1306_Clear(void)
{
    for (uint16_t i = 0; i < sizeof(framebuffer); i++)
    {
        framebuffer[i] = 0x00;
    }

    cursor_x = 0;
    cursor_y = 0;
}

void SSD1306_UpdateScreen(void)
{
    /* Set the addressing window to the full screen before each push */
    SSD1306_WriteCommand(0x21); /* set column address */
    SSD1306_WriteCommand(0x00);
    SSD1306_WriteCommand(SSD1306_WIDTH - 1);
    SSD1306_WriteCommand(0x22); /* set page address */
    SSD1306_WriteCommand(0x00);
    SSD1306_WriteCommand((SSD1306_HEIGHT / 8) - 1);

    /* Send the framebuffer in chunks, each prefixed with the data control byte */
    uint8_t chunk[17]; /* 1 control byte + 16 data bytes */
    uint16_t sent = 0;

    while (sent < sizeof(framebuffer))
    {
        uint16_t chunk_len = sizeof(framebuffer) - sent;
        if (chunk_len > 16)
        {
            chunk_len = 16;
        }

        chunk[0] = 0x40; /* control byte = data */
        for (uint16_t i = 0; i < chunk_len; i++)
        {
            chunk[i + 1] = framebuffer[sent + i];
        }

        HAL_I2C_Master_Transmit(&hi2c1, SSD1306_I2C_ADDRESS, chunk, chunk_len + 1, SSD1306_I2C_TIMEOUT);
        sent += chunk_len;
    }
}

void SSD1306_SetCursor(uint8_t x, uint8_t y)
{
    cursor_x = x;
    cursor_y = y;
}

void SSD1306_WriteChar(char ch)
{
    if (ch < 32 || ch > 126)
    {
        ch = '?';
    }

    const uint8_t *glyph = font5x7[ch - 32];
    uint8_t page = cursor_y / 8;

    if (cursor_x + 6 > SSD1306_WIDTH)
    {
        return; /* no wrap, just stop drawing past the edge */
    }

    for (uint8_t col = 0; col < 5; col++)
    {
        framebuffer[page * SSD1306_WIDTH + cursor_x + col] = glyph[col];
    }

    /* one blank column as spacing between characters */
    framebuffer[page * SSD1306_WIDTH + cursor_x + 5] = 0x00;

    cursor_x += 6;
}

void SSD1306_WriteString(const char *str)
{
    while (*str)
    {
        SSD1306_WriteChar(*str++);
    }
}

void SSD1306_ClearLine(uint8_t page)
{
    if (page >= SSD1306_HEIGHT / 8)
    {
        return;
    }

    for (uint8_t i = 0; i < SSD1306_WIDTH; i++)
    {
        framebuffer[page * SSD1306_WIDTH + i] = 0x00;
    }
}
